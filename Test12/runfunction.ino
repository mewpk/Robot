/*
 * move_to_point(จุดที่จะวิ่งไปหยิบชิ้นงาน)
 * move_line5_countV2(ความเร็วที่ใช้ไม่เกิน255, จำนวณเส้นตัดที่จะวิ่ง);
 * spin(ความเร็วในการหมุนตัว+หมุนทางขวา,-หมุนทางซ้าย); จะหมุน1เส้นตัด
 * spin2(ความเร็วในการหมุนตัว+หมุนทางขวา,-หมุนทางซ้าย); หุ่นยนต์จะเดินหน้าไปจนกลางหุ่นอยู่ตรงเส้นตัด แล้วจะหมุน 90 องศา หรือ 1 เส้นตัด
 * Keep_Object(); ใช้วิ่งเข้าไปจับชิ้นงานแล้วหุ่นยนต์จะหยุดที่จุดวางชิ้นงานพร้อมกลับหลังหันให้
 *  moveout(); ใช้วิ่งไปวางชิ้นงานที่จุด Start จากนั้นจะกลับหลังหันให้
 */

void move_to_point(int point)
{
  if (point == point_A)
  {
    move_line5_countV2(250, 4);
    spin(200);
    ////////////////////////////////////////////วิ่งไปจับSTART
    Keep_Object();
    ////////////////////////////////////////////วิ่งไปจับEND
    move_line5_countV2(250, 1);
    spin(-200);
    move_line5_countV2(250, 3);
    ///////////////////////////////////////////วิ่งเข้าจุดเริ่มSTART
    moveout();
    ///////////////////////////////////////////วิ่งเข้าจุดเริ่มEND
  }
  else if (point == point_B)
  {
   
  }
  else if (point == point_C)
  {
   

  }
  else if (point == point_D)
  {
    
  }
  else if (point == point_E)
  {
    

  }
  else if (point == point_F)
  {
    

  }
}
